## esp32_idf/main/Kconfig.projbuild
```kconfig
menu "WS90 MQTT Configuration"

config WS90_WIFI_SSID
    string "Wi-Fi SSID"
    default ""

config WS90_WIFI_PASS
    string "Wi-Fi Password"
    default ""

config WS90_MQTT_BROKER_URI
    string "MQTT Broker URI"
    default "mqtt://192.168.1.10:1883"

config WS90_MQTT_USERNAME
    string "MQTT Username"
    default ""

config WS90_MQTT_PASSWORD
    string "MQTT Password"
    default ""

config WS90_MQTT_STATE_TOPIC
    string "MQTT State Topic"
    default "ws90/state"

config WS90_REQUIRE_EXPECTED_ID
    bool "Require expected WS90 station ID"
    default y

config WS90_RADIO_DIAGNOSTICS
    bool "Enable periodic radio diagnostics"
    default y

config WS90_DIAG_INTERVAL_MS
    int "Radio diagnostics interval (ms)"
    range 500 60000
    default 3000
    depends on WS90_RADIO_DIAGNOSTICS

endmenu
```

## esp32_idf/sdkconfig.defaults
```kconfig
CONFIG_ESP_MAIN_TASK_STACK_SIZE=8192
CONFIG_LOG_DEFAULT_LEVEL_INFO=y
# CONFIG_ESP_TASK_WDT_EN is not set
```
